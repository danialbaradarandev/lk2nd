// SPDX-License-Identifier: GPL-2.0-only

/dts-v1/;

#include <skeleton.dtsi>
#include <lk2nd.h>

/ {
	model = "Sony Xperia Z2";
	compatible = "sony,sirius", "qcom,msm8974pro", "qcom,msm8974", "lk2nd,device";
	qcom,msm-id = <218 0x10000>;
	qcom,board-id = <8 0>;

	lk2nd,keys =
		<KEY_VOLUMEUP   PM_GPIO(5) PM_GPIO_PULL_UP_30>,
		<KEY_VOLUMEDOWN PM_GPIO(2) PM_GPIO_PULL_UP_30>;
};
